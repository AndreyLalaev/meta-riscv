## conf/machine/milkv-duo256m.conf
```bitbake
#@TYPE: Machine
#@NAME: milkv-duo256m
#@SOC: SOPHGO SG2002
#@DESCRIPTION: Machine configuration for Milk-V Duo256M

require milkv-duo.conf

UBOOT_MACHINE = "milkv_duo_256m_defconfig"

MACHINEOVERRIDES =. "milkv-duo:"
```
